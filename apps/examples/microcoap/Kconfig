## apps/examples/microcoap/Kconfig
```kconfig
#
# For a description of the syntax of this configuration file,
# see misc/tools/kconfig-language.txt.
#

config EXAMPLES_MICROCOAP
	bool "CoAP Example"
	default n
	---help---
		A small CoAP implementation for microcontrollers.
if EXAMPLES_MICROCOAP

config EXAMPLES_MICROCOAP_DEBUG
	bool "Enable CoAP Debug"
	default n
	---help---
		This enables the debug log of CoAP example.

endif
```

## apps/examples/mqttclient/Kconfig
```kconfig
#
# For a description of the syntax of this configuration file,
# see misc/tools/kconfig-language.txt.
#

if NETUTILS_MQTT

config EXAMPLES_MQTTCLIENT
	bool "MQTT Client Example"
	default n
	---help---
		Enable the MQTT client example

endif
```

## apps/examples/mqttpub/Kconfig
```kconfig
#
# For a description of the syntax of this configuration file,
# see misc/tools/kconfig-language.txt.
#

if NETUTILS_MQTT

config EXAMPLES_MQTTPUB
	bool "MQTT Client Publisher Example"
	default n
	---help---
		Enable the MQTT client publisher example

endif
```

## apps/examples/mqttsub/Kconfig
```kconfig
#
# For a description of the syntax of this configuration file,
# see misc/tools/kconfig-language.txt.
#

if NETUTILS_MQTT

config EXAMPLES_MQTTSUB
	bool "MQTT Client Subscriber Example"
	default n
	---help---
		Enable the MQTT client subscriber example

endif
```

## apps/examples/sockettest/Kconfig
```kconfig
#
# For a description of the syntax of this configuration file,
# see misc/tools/kconfig-language.txt.
#

config EXAMPLES_SOCKETTEST
	bool "Socket Test example"
	default n
	---help---
		Enable the socket test example
```

## apps/netutils/mqtt/Kconfig
```kconfig
#
# For a description of the syntax of this configuration file,
# see misc/tools/kconfig-language.txt.
#

config NETUTILS_MQTT
	bool "MQTT"
	default n
	depends on NET_TCP
	---help---
		Enable support for the MQTT protocol.
		  - OASIS Message Queuing Telemetry Transport (MQTT)

if NETUTILS_MQTT

endif
```

## apps/system/debug/Kconfig
```kconfig
#
# For a description of the syntax of this configuration file,
# see misc/tools/kconfig-language.txt.
#

config SYSTEM_DEBUG
	bool "Customized Debug Support"
	default n
	---help---
		Enable debug support for Nuttx.

if SYSTEM_DEBUG
endif
```

## nuttx/configs/stm32-leach/Kconfig
```kconfig
#
# For a description of the syntax of this configuration file,
# see misc/tools/kconfig-language.txt.
#

if ARCH_BOARD_STM32_LEACH

choice
	prompt "Select board version"
	default LEACH_MINI
	---help---
		Select the board hosting the architure.  You must first select the
		exact MCU part number, then the boards supporting that part will
		be available for selection.  Use ARCH_BOARD_CUSTOM to create a new
		board configuration.

config LEACH_NORMAL
	bool "Select leach normal version"
	default y
	---help---
		This version is the normal leach board.

config LEACH_MINI
	bool "Select leach mini version"
	default n
	---help---
		This version is a mini layout of the normal one.
		It has different bootloader, memory size, and pin layout.

endchoice

endif
```
